## Config.in
```kconfig
menuconfig BR2_PACKAGE_LONGDONG
	bool "FIKA longdong project"
	help
	  Support for FIKA longdong libraries, servers, drivers, and/or
	  applications in the project.

	  https://github.com/koralden/longdong.git

if BR2_PACKAGE_LONGDONG
	#menu "Longdong Utilities"
	#	source package/x11r7/xutil_makedepend/Config.in
	#	source package/x11r7/mcookie/Config.in
	#endmenu
        source package/longdong/libs/aws-iot-device-sdk-embedded-C/Config.in
        source package/longdong/net/fika-iot-gateway/Config.in
        source package/longdong/net/fika-easy-setup/Config.in
        source package/longdong/net/fika-opennds/Config.in
endif

comment "longdong needs a toolchain w/ static library"
	depends on !BR2_STATIC_LIBS
```

## libs/aws-iot-device-sdk-embedded-C/Config.in
```kconfig
config BR2_PACKAGE_AWS_IOT_DEVICE_SDK_EMBEDDED_C
	bool "aws-iot-device-sdk-embedded-C"
	select BR2_PACKAGE_OPENSSL
	help
	  Amazon AWS IoT Hub device SDK for C is used
	  to connect devices running C code to Azure IoT Hub.

	  https://github.com/aws/aws-iot-device-sdk-embedded-C
```

## net/fika-easy-setup/Config.in
```kconfig
config BR2_PACKAGE_FIKA_EASY_SETUP
	bool "fika-easy-setup"
	depends on BR2_PACKAGE_HOST_RUSTC_TARGET_ARCH_SUPPORTS
	select BR2_PACKAGE_HOST_RUSTC
	help
	  Fikapark easy setup for longdong project
```

## net/fika-iot-gateway/Config.in
```kconfig
config BR2_PACKAGE_FIKA_IOT_GATEWAY
	bool "fika-iot-gateway
	select BR2_PACKAGE_LIBUV
	select BR2_PACKAGE_HIREDIS
        select BR2_PACKAGE_LIBYAML
        select BR2_PACKAGE_AWS_IOT_SDK_C
	select BR2_PACKAGE_OPENSSL
	help
	  FIKA IoT Gateway in C
	  to connect devices running C code to AWS IoT Core.

	  https://github.com/koralden/longdong
```

## net/fika-opennds/Config.in
```kconfig
config BR2_PACKAGE_FIKA_OPENNDS
	bool "fika-opennds"
	select BR2_PACKAGE_LIBMICROHTTPD
	#select BR2_PACKAGE_HIREDIS
        #select BR2_PACKAGE_LIBYAML
	help
          openNDS is a Captive Portal solution that offers an instant way to provide restricted access to the Internet.
          With little or no configuration, a dynamically generated and adaptive splash page sequence is automatically served.
          Both client driven Captive Portal Detection (CPD) and gateway driven Captive Portal Identification (CPI - RFC 8910 and RFC 8908) are supported.
          Internet access is granted by either a click to continue button, or after credential verification as a result of filling in a login form.
          The package incorporates the FAS API allowing many flexible customisation options.
          The creation of sophisticated third party authentication applications is fully supported.
          Internet hosted https portals can be implemented with no security errors, to inspire maximum user confidence.
          This version requires iptables-nft.

          https://github.com/opennds/opennds
```

## system/fika-manager/Config.in
```kconfig
config BR2_PACKAGE_FIKA_MANAGER
	bool "fika-manager"
	depends on BR2_PACKAGE_HOST_RUSTC_TARGET_ARCH_SUPPORTS
	select BR2_PACKAGE_HOST_RUSTC
	select BR2_PACKAGE_JQ
	help
	  Fikapark core manager for longdong project
```
